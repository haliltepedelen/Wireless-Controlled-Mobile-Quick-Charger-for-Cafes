
#include <WiFi.h>
#include <Wire.h>
//#include <LiquidCrystal_I2C.h>
#include <driver/adc.h>
#include <HTTPClient.h>
#include "ESPAsyncWebServer.h"
#include "SPIFFS.h"

//#include <SPI.h>
#include <Adafruit_GFX.h>
#include <Adafruit_SSD1306.h>

#define SCREEN_WIDTH 128 // OLED display width, in pixels
#define SCREEN_HEIGHT 64 // OLED display height, in pixels
#define OLED_RESET     -1 // Reset pin # (or -1 if sharing Arduino reset pin)
#define SCREEN_ADDRESS 0x3c ///< See datasheet for Address; 0x3D for 128x64, 0x3C for 128x32
Adafruit_SSD1306 display(SCREEN_WIDTH, SCREEN_HEIGHT, &Wire, OLED_RESET);

#define LOGO_HEIGHT   64
#define LOGO_WIDTH    128
// 'logo_hbntechnology (1)', 128x64px
const unsigned char myBitmap [] PROGMEM = {
  
  0x7f, 0x80, 0x03, 0xfe, 0x00, 0x00, 0x7f, 0xff, 0xff, 0xf0, 0x00, 0x00, 0x7f, 0x80, 0x01, 0xff, 
  0x7f, 0x80, 0x03, 0xfe, 0x00, 0x00, 0x7f, 0xff, 0xff, 0xfc, 0x00, 0x00, 0x7f, 0xc0, 0x01, 0xff, 
  0x7f, 0x80, 0x03, 0xfe, 0x00, 0x00, 0x7f, 0xff, 0xff, 0xfc, 0x00, 0x00, 0x7f, 0xc0, 0x01, 0xff, 
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  0x0e, 0x0f, 0xf8, 0xff, 0xc3, 0x07, 0x1c, 0x1c, 0x3f, 0xe1, 0xfe, 0x3f, 0xf0, 0xff, 0xc0, 0x60
};

// 'logo_hbntechnology (1)', 128x32px
const unsigned char myBitmap6 [] PROGMEM = {
  0x7f, 0x80, 0x03, 0xfc, 0x00, 0x00, 0x7f, 0xff, 0xff, 0xf0, 0x00, 0x00, 0x3f, 0x80, 0x01, 0xfe, 
  0x7f, 0x80, 0x03, 0xfc, 0x00, 0x00, 0x7f, 0xff, 0xff, 0xfc, 0x00, 0x00, 0x3f, 0xc0, 0x01, 0xfe, 
  0x7f, 0x80, 0x03, 0xfc, 0x00, 0x00, 0x7f, 0x80, 0x03, 0xfc, 0x00, 0x00, 0x3f, 0xe0, 0x01, 0xfe, 
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  0x1f, 0x0f, 0xfd, 0xff, 0xe7, 0x8f, 0x9e, 0x3e, 0xff, 0xfb, 0xff, 0x7f, 0xfb, 0xff, 0xe0, 0xf0
};
// 'Battery-25-icon', 16x16px
const unsigned char myBitmap1 [] PROGMEM = {
  0x00, 0x00, 0x00, 0x00, 0x00, 0x00, 0x00, 0x00, 0x7f, 0xfc, 0x80, 0x04, 0xb0, 0x03, 0xa0, 0x01, 
  0xa0, 0x01, 0xb0, 0x03, 0x80, 0x04, 0x7f, 0xfc, 0x00, 0x00, 0x00, 0x00, 0x00, 0x00, 0x00, 0x00
};
// 'Battery-50-icon', 16x16px
const unsigned char myBitmap2 [] PROGMEM = {
  0x00, 0x00, 0x00, 0x00, 0x00, 0x00, 0x00, 0x00, 0x7f, 0xfc, 0x80, 0x04, 0xb6, 0x03, 0xa6, 0x01, 
  0xa6, 0x01, 0xb6, 0x03, 0x80, 0x04, 0x7f, 0xfc, 0x00, 0x00, 0x00, 0x00, 0x00, 0x00, 0x00, 0x00
};
// 'Battery-75-icon', 16x16px
const unsigned char myBitmap3 [] PROGMEM = {
  0x00, 0x00, 0x00, 0x00, 0x00, 0x00, 0x00, 0x00, 0x7f, 0xfc, 0x80, 0x04, 0xb6, 0xc3, 0xa6, 0x41, 
  0xa6, 0x41, 0xb6, 0xc3, 0x80, 0x04, 0x7f, 0xfc, 0x00, 0x00, 0x00, 0x00, 0x00, 0x00, 0x00, 0x00
};
// 'Battery-100-icon', 16x16px
const unsigned char myBitmap4 [] PROGMEM = {
  0x00, 0x00, 0x00, 0x00, 0x00, 0x00, 0x00, 0x00, 0x7f, 0xfc, 0x80, 0x04, 0xb6, 0xf3, 0xa6, 0x61, 
  0xa6, 0x61, 0xb6, 0xf3, 0x80, 0x04, 0x7f, 0xfc, 0x00, 0x00, 0x00, 0x00, 0x00, 0x00, 0x00, 0x00
};
// 'No-Battery-icon', 16x16px
const unsigned char myBitmap5 [] PROGMEM = {
  0x00, 0x00, 0x00, 0x00, 0x00, 0x00, 0x00, 0x00, 0x7f, 0xfc, 0x80, 0x04, 0x82, 0x83, 0x85, 0xc1, 
  0x86, 0x41, 0x82, 0x83, 0x80, 0x04, 0x7f, 0xfc, 0x00, 0x00, 0x00, 0x00, 0x00, 0x00, 0x00, 0x00
};

// 'pngwing', 16x16px
const unsigned char myBitmap7 [] PROGMEM = {
  0x00, 0x00, 0x00, 0x00, 0x07, 0xe0, 0x1f, 0xf8, 0x70, 0x0e, 0xe3, 0xc7, 0x8f, 0xf1, 0x18, 0x18, 
  0x13, 0xc8, 0x07, 0xe0, 0x00, 0x00, 0x01, 0x80, 0x01, 0x80, 0x01, 0x80, 0x00, 0x00, 0x00, 0x00
};


int a = 0;
int b = 0;
int count = 0; 
int count1 = 0;
int high = 0;
int high1 = 0;
bool requesT = false;
bool isFinnished = false;
//LiquidCrystal_I2C lcd(0x27, 16, 2);
const char* ssid     = "ENTEGRE";
const char* password = "123456789";
const int Analog_channel_pin = 36;
int ADC_VALUE = 0;
double voltage_value = 0;
int RequestPin = 16;
AsyncWebServer server(80);
int coinpin = 4;

int btnPressCount = 0;
long chargeST = 0;
bool charge30min = false;


String readRequest() {
  a = digitalRead(RequestPin);

  if (a == HIGH) {
    Serial.println("Requesting...");
    return String("Requesting...");
    delay(1000);
  }
  else if (a == LOW) {
    Serial.println("Not Requesting...");
    return String("Not Requesting...");
    delay(1000);
  }
  return "";
}

String processor(const String& var) {
  //Serial.println(var);
  if (var == "REKUEST") {
    return readRequest();
  }
  return String();
}


void setup()
{
  Wire.begin();
  Serial.begin(115200);

  
  // SSD1306_SWITCHCAPVCC = generate display voltage from 3.3V internally
  if(!display.begin(SSD1306_SWITCHCAPVCC, SCREEN_ADDRESS)) {
    Serial.println(F("SSD1306 allocation failed"));
    for(;;); // Don't proceed, loop forever
  }

  if (!SPIFFS.begin(true)) {
    Serial.println("An Error has occurred while mounting SPIFFS");
    return;
  }

  pinMode(5, OUTPUT);
  pinMode(12, OUTPUT);
  pinMode(17, INPUT);
  pinMode(16, INPUT);
  delay(10);

   display.clearDisplay();

   display.drawBitmap(0,0,myBitmap,128,64, 1);
  display.display();
  delay(2000);
  //lcd.init();
  //lcd.backlight();

  //lcd.clear();
  //lcd.setCursor(2, 2);
  //lcd.print("    WELCOME!    ");
 // delay(1500);
display.clearDisplay();
  display.setTextSize(2);             
  display.setTextColor(SSD1306_WHITE);       
  display.setCursor(10,24);             
  display.println("WELCOME");
  display.display();
  delay(2000);
  //lcd.setCursor(0, 0);
  //lcd.print("Portable Charger");
  //lcd.setCursor(0, 1);
  //lcd.print("       PT       ");
  //delay(2500);

  Serial.println();
  Serial.println();
  Serial.print("Connecting to ");
  Serial.println(ssid);
  delay(1000);
  //lcd.clear();
  //lcd.setCursor(0, 16);
  //lcd.print("..Connecting to.");
  //lcd.setCursor(5, 1);
  //lcd.print("ROUTER");
  //delay(2000);
  display.clearDisplay();
  display.setTextSize(1);             
  display.setTextColor(SSD1306_WHITE);       
  display.setCursor(6,17);             
  display.println("..Connecting to.");
  display.setCursor(10,32);
  display.println("Router");
  display.display();
  delay(2000);
  WiFi.begin(ssid, password);
  while (WiFi.status() != WL_CONNECTED) {
    delay(500);
    Serial.println("Connecting to WiFi..");
  }

  Serial.println("");
  Serial.println("WiFi connected.");
  Serial.println("IP address: ");
  Serial.println(WiFi.localIP());

  //lcd.clear();
  //lcd.setCursor(1, 0);
  //lcd.print("WiFi connected");
  //lcd.setCursor(1, 1);
  //lcd.print(WiFi.localIP());
  //delay(2500);
display.clearDisplay();
  display.setTextSize(1);             
  display.setTextColor(SSD1306_WHITE);       
  display.setCursor(6,17);             
  display.println("WiFi connected");
  display.setCursor(2,32); 
  display.println(WiFi.localIP());
  display.display();
  delay(2000);
 display.drawBitmap(94,0,myBitmap7, 16, 16, 1);
  display.display();
 delay(2000);
  
  //lcd.clear();
  //lcd.setCursor(0, 0);
  //lcd.print("Portable Charger");
  //lcd.setCursor(0, 1);
  //lcd.print("       PT       ");
  //delay(2500);
display.clearDisplay();
  display.setTextSize(1);             
  display.setTextColor(SSD1306_WHITE);       
  display.setCursor(8,17);             
  display.println("HBN Technology");
  display.setCursor(6,32);
  display.println("Portable Charger");
  display.display();
  delay(2000);
  initial();

  server.on("/", HTTP_GET, [](AsyncWebServerRequest * request) {
    request->send(SPIFFS, "/index.html", String(), false, processor);
  });
  server.on("/style.css", HTTP_GET, [](AsyncWebServerRequest * request) {
    request->send(SPIFFS, "/style.css", "text/css");
  });
  server.on("/rekuest", HTTP_GET, [](AsyncWebServerRequest * request) {
    request->send_P(200, "text/plain", readRequest().c_str());
  });



  server.on("/H", HTTP_GET, [](AsyncWebServerRequest * request) {
    request->send(SPIFFS, "/index.html", String(), false, processor);
    high = HIGH;
    isFinnished = false;
  });



  server.on("/L", HTTP_GET, [](AsyncWebServerRequest * request) {
    digitalWrite(5, LOW);
    request->send(SPIFFS, "/index.html", String(), false, processor);
    high = LOW;
    isFinnished = true;
  });



  server.on("/I", HTTP_GET, [](AsyncWebServerRequest * request) {
    request->send(SPIFFS, "/index.html", String(), false, processor);
    high1 = HIGH;
    isFinnished = false;
  });



  server.on("/J", HTTP_GET, [](AsyncWebServerRequest * request) {
    digitalWrite(12, LOW);
    request->send(SPIFFS, "/index.html", String(), false, processor);
    high1 = LOW;
    isFinnished = true;
  });

  server.begin();
}

void loop() {
  batterylevel();

  a = digitalRead(RequestPin);
  long startT = millis();
  while(millis() - startT < 5000) {
    a = digitalRead(RequestPin);
    if ( a == HIGH)
      btnPressCount++;
         
  }
  if(btnPressCount == 3) {
    btnPressCount = 0;
    chargeST = millis();
    digitalWrite(5, HIGH);
    high1 = HIGH;
    isFinnished = false;
    charge30min = true;
    display.clearDisplay();
  display.setTextSize(1);             
  display.setTextColor(SSD1306_WHITE);       
  display.setCursor(8,17);             
  display.println("HBN TECHNOLOGY");
  display.setCursor(15,32);
  display.println("CHARGING");
  display.display();
  delay(2000);
  }
  if (btnPressCount == 1) {
        display.clearDisplay();
  display.setTextSize(1);             
  display.setTextColor(SSD1306_WHITE);       
  display.setCursor(6,17);             
  display.println("HBN TECHNOLOGY");
  display.println("Request Sent");
  display.display();
  delay(10000);
    //lcd.clear();
   // lcd.setCursor(2, 0);
    //lcd.print("Request Sent");
    btnPressCount = 0;
    
    return initial();
    
  }

  if(charge30min == true) {
    if((millis() - startT) > 1800000) {
      high1 = LOW;
      isFinnished = true;
      charge30min = false;
    }
  }

  if (high == HIGH && isFinnished == false) {
    digitalWrite(5, HIGH);
    //lcd.clear();
    //lcd.setCursor(4, 0);
    //lcd.print("CHARGING");
    //delay (2000);
    display.clearDisplay();
  display.setTextSize(1);             
  display.setTextColor(SSD1306_WHITE);       
  display.setCursor(8,17);             
  display.println("HBN TECHNOLOGY");
   display.setCursor(15,32);
  display.println("CHARGING");
  display.display();
  delay(2000);
    
  }
  else if (high == LOW && isFinnished == true) {
    //lcd.clear();
    //lcd.setCursor(0, 0);
    //lcd.print("ChargingFinished");
    //delay(2000);
    isFinnished = false;
    return initial();
    display.clearDisplay();
  display.setTextSize(1);             
  display.setTextColor(SSD1306_WHITE);       
  display.setCursor(8,17);             
  display.println("HBN TECHNOLOGY");
  display.println("ChargingFinished");
  display.display();
  delay(2000);
  }
  if (high1 == HIGH && isFinnished == false) {
    digitalWrite(12, HIGH);
   // lcd.clear();
    //lcd.setCursor(0, 0);
    //lcd.print("WirelessCHARGING");
  }
  else if (high1 == LOW && isFinnished == true) {
    //lcd.clear();
    //lcd.setCursor(0, 0);
    //lcd.print("ChargingFinished");
    //delay(2000);
    isFinnished = false;
    return initial();
  }
}

void initial() {
 // lcd.clear();
  //lcd.setCursor(0, 0);
  //lcd.print("   Press  For   ");
  //lcd.setCursor(1, 1);
 // lcd.print("   Charging    ");
  //delay(1000);

      display.clearDisplay();
  display.setTextSize(1);             
  display.setTextColor(SSD1306_WHITE);       
  display.setCursor(8,17);             
  display.println("HBN TECHNOLOGY");
  display.setCursor(0,32);
  display.println("Press  For Charging");
  display.display();
  delay(2000);
   display.drawBitmap(94,0,myBitmap7, 16, 16, 1);
  display.display();

  
}

void batterylevel() {
  ADC_VALUE = analogRead(Analog_channel_pin);
  Serial.print("ADC VALUE = ");
  Serial.println(ADC_VALUE);
  delay(1000);
  voltage_value = ADC_VALUE;

  if (voltage_value > 3600)
  {
    
  display.drawBitmap(111,0,myBitmap4, 16, 16, 1);
  display.display();
  delay(1000);
  }
  if (voltage_value <=3200  && voltage_value > 2601)
  {
 display.drawBitmap(111,0,myBitmap3, 16, 16, 1);
  display.display();
  delay(1000);
  }
  if (voltage_value <= 2600 && voltage_value > 2000)
  {
  display.drawBitmap(111,0,myBitmap2, 16, 16, 1);
  display.display();
  delay(1000);
  }
  if (voltage_value <= 2000 && voltage_value > 1401)
  {
display.drawBitmap(111,0,myBitmap1, 16, 16, 1);
  display.display();
  delay(1000);
  }
  if (voltage_value <= 1400) 
  {
 
   display.drawBitmap(111,0,myBitmap5, 16, 16, 1);
  display.display();
  delay(1000);
}

 
}
